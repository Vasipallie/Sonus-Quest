//IMPORTS
#include <Arduino.h>
#include "BluetoothA2DPSource.h"
#include "BluetoothSerial.h"
#include "esp_gap_bt_api.h"
#include <SPI.h>
#include <SD.h>
#include <Adafruit_GFX.h>
#include <Adafruit_ST7735.h>
//PINS
#define TFT_CS   27
#define TFT_RST  33
#define TFT_DC   26
#define TFT_MOSI 25
#define TFT_SCLK 32
#define TFT_BL   14
const int SD_CS_PIN = 5;
#define MAX_DEVICES 13

//LOPAKA STUFF & Icons
String TARGET_SPEAKER = "NULL";
esp_bd_addr_t TARGET_ADDR = {0};
BluetoothA2DPSource a2dp_source;
BluetoothSerial SerialBT;
File                audio_file;
volatile bool       audio_sd_ready  = false;
volatile bool       audio_switch_pending = false;
volatile int        audio_pending_index  = -1;
int                 audio_playing_index  = -1;

// BT connection state — set only from BT callbacks, read from main task
volatile bool       bt_connected         = false;
volatile bool       bt_status_changed    = false;  // triggers a status-bar redraw in loop()
volatile bool       pending_addr_save    = false;  // set when we learn the addr by name-match

volatile float      volume_gain          = 0.5f;
volatile int        current_volume       = 8;
const int           MAX_VOLUME           = 10;
const int           MIN_VOLUME           = 0;


struct AudioDevice {
  String  name;
  String  address;
};

AudioDevice foundDevices[MAX_DEVICES];
int selectedIndex = 0;
String deviceNames[MAX_DEVICES];
int deviceCount = 0;

String screenname ="";
/* 
ALL SCREEN NAMES
- "HOMEM"
- "HOMEC"
- "MUSILIST"
- "PLAYING"
- "CONNECT"
*/

// Returns the top-bar text: speaker name when connected, "not connected" otherwise
inline String getStatusText() {
  return bt_connected ? TARGET_SPEAKER : String("Not Connected");
}

static const int RECONNECT_INTERVAL = 0.5;   
class LopakaST7735 : public Adafruit_ST7735 {
public:
  using Adafruit_ST7735::Adafruit_ST7735;

  void setFreeFont(const GFXfont* f) { setFont(f); }

  int16_t drawString(const char* text, int16_t x, int16_t y) {
    int16_t x1, y1;
    uint16_t w, h;
    getTextBounds(text, 0, 0, &x1, &y1, &w, &h);
    setCursor(x, y - y1);
    print(text);
    return static_cast<int16_t>(w);
  }

  int16_t drawString(const String& text, int16_t x, int16_t y) {
    return drawString(text.c_str(), x, y);
  }
};
LopakaST7735 tft(TFT_CS, TFT_DC, TFT_MOSI, TFT_SCLK, TFT_RST);
const uint8_t FreeSerifBoldItalic9pt7bBitmaps[] PROGMEM = {
    0x0C, 0x31, 0xC6, 0x18, 0x41, 0x08, 0x20, 0x0E, 0x38, 0xE0, 0xCF, 0x38,
    0xA2, 0x88, 0x02, 0x40, 0xC8, 0x13, 0x06, 0x43, 0xFC, 0x32, 0x06, 0x40,
    0x98, 0x7F, 0x84, 0xC0, 0x90, 0x32, 0x04, 0xC0, 0x01, 0x01, 0xF0, 0x4B,
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    0x71, 0x8F};
const GFXglyph FreeSerifBoldItalic9pt7bGlyphs[] PROGMEM = {
    {0, 0, 0, 5, 0, 1},         // 0x20 ' '
    {0, 6, 13, 7, 1, -11},      // 0x21 '!'
    {10, 6, 5, 10, 3, -11},     // 0x22 '"'
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    {1308, 8, 2, 10, 1, -4}};   // 0x7E '~'
const GFXfont FreeSerifBoldItalic9pt7b PROGMEM = {
    (uint8_t *)FreeSerifBoldItalic9pt7bBitmaps,
    (GFXglyph *)FreeSerifBoldItalic9pt7bGlyphs, 0x20, 0x7E, 22};
const uint8_t FreeSans9pt7bBitmaps[] PROGMEM = {
    0xFF, 0xFF, 0xF8, 0xC0, 0xDE, 0xF7, 0x20, 0x09, 0x86, 0x41, 0x91, 0xFF,
    0x13, 0x04, 0xC3, 0x20, 0xC8, 0xFF, 0x89, 0x82, 0x61, 0x90, 0x10, 0x1F,
    0x14, 0xDA, 0x3D, 0x1E, 0x83, 0x40, 0x78, 0x17, 0x08, 0xF4, 0x7A, 0x35,
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    0x66, 0x67, 0x37, 0x66, 0x66, 0x66, 0xC0, 0x61, 0x24, 0x38};
const GFXglyph FreeSans9pt7bGlyphs[] PROGMEM = {
    {0, 0, 0, 5, 0, 1},        // 0x20 ' '
    {0, 2, 13, 6, 2, -12},     // 0x21 '!'
    {4, 5, 4, 6, 1, -12},      // 0x22 '"'
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    {1147, 7, 3, 9, 1, -7}};   // 0x7E '~'
const GFXfont FreeSans9pt7b PROGMEM = {(uint8_t *)FreeSans9pt7bBitmaps,
                                       (GFXglyph *)FreeSans9pt7bGlyphs, 0x20,
                                       0x7E, 22};
static const unsigned char PROGMEM image_Warning_bits[] = {0x00,0x03,0x00,0x00,0x00,0x07,0x80,0x00,0x00,0x0f,0xc0,0x00,0x00,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0xff,0xf8};
static const unsigned char PROGMEM image_music_sound_wave_bits[] = {0x00,0x00,0x00,0x00,0x00,0x00,0x00,0x00,0x00,0x00,0x00,0x00,0x00,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0x00,0x00};
static const uint16_t PROGMEM image_paint_6_pixels[] = {0x72B2,0x0000,0x0000,0x0000,0x0000,0x0000,0x0000,0x0000,0x0000,0x0000,0x0000,0x0000,0x0000,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0x0000,0x72B2};
static const unsigned char PROGMEM image_Voldwn_bits[] = {0x10,0x30,0xf4,0xf4,0x30,0x10};
static const unsigned char PROGMEM image_Volup_bits[] = {0x12,0x31,0xf5,0xf5,0x31,0x12};


// Error Screen
void scerror(String message){
    tft.fillScreen(0x1042);
    tft.drawBitmap(2, 6, image_Warning_bits, 30, 23, 0xFFFF);
    tft.setTextColor(0xFFFF);
    tft.setTextSize(1);
    tft.setFreeFont(&FreeSans9pt7b);
    tft.drawString("System Error", 2, 31);
    tft.setFreeFont(NULL);
    tft.drawString("Your Sonus Quest has", 2, 51);
    tft.drawString(message, 1, 61);
    tft.drawString("Please fix this error", 1, 142);
    tft.drawString("and restart", 1, 150);
}
//MIDDLEWARE
//Initalise SD

void updateStatusBar() {
  tft.fillRect(0, 0, 128, 11, 0x1042);
  tft.setTextSize(1);
  tft.setFreeFont(NULL);
  tft.setTextColor(bt_connected ? (uint16_t)0xFFFF : (uint16_t)0xF800);
  tft.drawString(getStatusText(), 1, 2);
}
static bool init_sd(uint8_t cs_pin, uint8_t max_retries = 5) {
    for (uint8_t attempt = 1; attempt <= max_retries; ++attempt) {
        Serial.printf("[SD] Init attempt %d/%d (CS=GPIO%d)...\n",
                      attempt, max_retries, cs_pin);
        if (SD.begin(cs_pin)) {
            uint8_t card_type = SD.cardType();
            const char* type_str = "UNKNOWN";
            if      (card_type == CARD_MMC)  type_str = "MMC";
            else if (card_type == CARD_SD)   type_str = "SDSC";
            else if (card_type == CARD_SDHC) type_str = "SDHC";
            else if (card_type == CARD_NONE) type_str = "NONE (no card?)";

            Serial.printf("[SD] Card type : %s\n", type_str);
            Serial.printf("[SD] Card size : %llu MB\n",
                          SD.cardSize() / (1024ULL * 1024ULL));
            Serial.printf("[SD] Total space: %llu MB used / %llu MB total\n",
                          SD.usedBytes() / (1024ULL * 1024ULL),
                          SD.totalBytes() / (1024ULL * 1024ULL));
            return true;
        }
        Serial.printf("[SD] Mount failed on attempt %d. Retrying in 1 s...\n", attempt);
        delay(1000);
    }
    return false;
}
// get songlist 
const int MAX_SONGS = 20;
const int VIEW_ROWS = 10;

String Index[MAX_SONGS];
String Title[MAX_SONGS];
String Artist[MAX_SONGS];
String Filename[MAX_SONGS];
String Duration[MAX_SONGS];

int songCount = 0;
int selectedSong = 0;
int visibleTop = 0;
void clearSongList() {
  songCount = 0;
  for (int i = 0; i < MAX_SONGS; i++) {
    Index[i] = "";
    Title[i] = "";
    Artist[i] = "";
    Filename[i] = "";
    Duration[i] = "";
  }
}

void parseLine(String line, int i) {
  int dash = line.indexOf('-');
  int eq = line.indexOf('=');
  int plus = line.indexOf('+');
  int gt = line.indexOf('>');

  if (dash < 0 || eq < 0 || plus < 0 || gt < 0) return;

  Index[i] = line.substring(0, dash);
  Title[i] = line.substring(dash + 1, eq);
  Artist[i] = line.substring(eq + 1, plus);
  Filename[i] = line.substring(plus + 1, gt);
  Duration[i] = line.substring(gt + 1);
}

void get_songlist(int songpos) {
  clearSongList();

  File file = SD.open("/sdir.txt");
  if (!file) {
    scerror("SDir Not Found");
    return;
  }

  int current = -1;
  while (file.available() && songCount < MAX_SONGS) {
    String line = file.readStringUntil(';');
    line.trim();
    if (line.length() == 0) continue;

    current++;
    if (current < songpos) continue;

    parseLine(line, songCount);
    if (Title[songCount].length() > 0) {
      songCount++;
    }
  }

  file.close();

  selectedSong = 0;
  visibleTop = 0;
}

void saveSpeaker(const String& name, const esp_bd_addr_t addr) {
  SD.remove("/data.txt");
  File f = SD.open("/data.txt", FILE_WRITE);
  if (!f) {
    Serial.println("[SD] Could not open data.txt for writing");
    return;
  }
  f.print("SPEAKER:");
  f.println(name);
  char addrBuf[18];
  snprintf(addrBuf, sizeof(addrBuf), "%02x:%02x:%02x:%02x:%02x:%02x",
           addr[0], addr[1], addr[2], addr[3], addr[4], addr[5]);
  f.print("ADDR:");
  f.println(addrBuf);
  f.close();
  Serial.printf("[SD] Saved speaker: %s  addr: %s\n", name.c_str(), addrBuf);
}

// SCREENS & its middleware 
// HOME Music hightlighted
void homem(){
    tft.fillScreen(0x1042);
    tft.setTextColor(0xE459);
    tft.setTextSize(1);
    tft.setFreeFont(&FreeSans9pt7b);
    tft.setTextColor(bt_connected ? (uint16_t)0xFFFF : (uint16_t)0xF800);
    tft.setFreeFont(NULL);
    tft.drawString(getStatusText(), 1, 2);
    tft.setTextColor(0xFFFF);
    tft.setTextSize(2);
    tft.setFreeFont(&FreeSans9pt7b);
    tft.drawString("music", -1, 11);
    tft.drawLine(0, 11, 127, 11, 0xFFFF);
    tft.setTextColor(0xE499);
    tft.setTextSize(1);
    tft.drawString("connect", 0, 38);
    tft.setTextColor(0xFFFF);
    tft.setFreeFont(NULL);
}
//HOME Connect highlighted
void homec(){
tft.fillScreen(0x1042);
tft.setTextSize(1);
tft.setTextColor(bt_connected ? (uint16_t)0xFFFF : (uint16_t)0xF800);
tft.setFreeFont(NULL);
tft.drawString(getStatusText(), 1, 2);
tft.setTextColor(0xECFA);
tft.setFreeFont(&FreeSans9pt7b);
tft.drawString("music", 1, 13);
tft.drawLine(0, 11, 127, 11, 0xFFFF);
tft.setTextColor(0xFFFF);
tft.setTextSize(2);
tft.drawString("connect", 0, 24);

}
void musiclist() {
  tft.fillScreen(0x1042);

  tft.drawLine(0, 11, 127, 11, 0xFFFF);
  tft.drawLine(0, 13, 127, 13, 0xFFFF);

  int maxVisibleTop = max(0, songCount - VIEW_ROWS);
  if (selectedSong < visibleTop) visibleTop = selectedSong;
  if (selectedSong >= visibleTop + VIEW_ROWS) visibleTop = selectedSong - VIEW_ROWS + 1;
  if (visibleTop > maxVisibleTop) visibleTop = maxVisibleTop;

  tft.setTextSize(1);
  tft.setFreeFont(NULL);

  for (int row = 0; row < VIEW_ROWS; row++) {
    int songIndex = visibleTop + row;
    if (songIndex >= songCount) break;

    int y = 47 + row * 11;
    tft.setTextColor(songIndex == selectedSong ? 0xFFFF : 0xE499);
    tft.drawString(Title[songIndex] + "-" + Artist[songIndex], 3, y);
  }

  tft.setTextSize(2);
  tft.setFreeFont(&FreeSans9pt7b);
  tft.setTextColor(0xFFFF);
  tft.drawString("Music", 1, 17);

  tft.setTextSize(1);
  tft.setFreeFont(NULL);
  tft.setTextColor(bt_connected ? (uint16_t)0xFFFF : (uint16_t)0xF800);
  tft.drawString(getStatusText(), 1, 2);
}
void boot(){
  static const unsigned char PROGMEM image_Iuf6aj_6ahZohbxT5Jb8q_transformed_bits[] = {0x00,0x00,0x00,0x00,0x00,0x00,0x00,0x00,0x00,0x00,0x00,0x00,0x00,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0x00,0x00};
  tft.fillScreen(0x1042);
  tft.drawBitmap(34, 45, image_Iuf6aj_6ahZohbxT5Jb8q_transformed_bits, 64, 43, 0xFFFF);
  tft.setTextColor(0xFFFF);
  tft.setTextSize(1);
  tft.drawString("Sonus Quest", 32, 84);
}

void update_volume_gain() {
  if (current_volume <= MIN_VOLUME) {
    volume_gain = 0.0f;
  } else if (current_volume >= MAX_VOLUME) {
    volume_gain = 1.0f;
  } else {
    float db = -30.0f + 30.0f * (float)(current_volume - 1) / (float)(MAX_VOLUME - 1);
    volume_gain = pow(10.0f, db / 20.0f);
  }
  Serial.printf("[VOLUME] Level: %d, Gain: %.4f\n", current_volume, volume_gain);
}
void draw_volume_bar() {
  if (screenname == "PLAYING") {
    tft.fillRect(13, 151, 100, 4, 0x1042);
    tft.fillRect(13, 152, 100, 2, 0xB272);
    if (current_volume > 0) {
      tft.fillRect(13, 151, current_volume * 10, 4, 0xFFFF);
    }
  }
}
void volup() {
  if (current_volume < MAX_VOLUME) {
    current_volume++;
    update_volume_gain();
    draw_volume_bar();
  }
}
void voldown() {
  if (current_volume > MIN_VOLUME) {
    current_volume--;
    update_volume_gain();
    draw_volume_bar();
  }
}
void connect(){
  // Show scanning screen
  tft.fillScreen(0x1042);
  tft.setTextColor(0xECFA);
  tft.setTextSize(2);
  tft.setFreeFont(&FreeSans9pt7b);
  tft.drawString("connect", 1, -3);
  tft.setTextColor(0xFFFF);
  tft.setTextSize(1);
  tft.setFreeFont(NULL);
  tft.drawString("Scanning...", 27, 73);

  deviceCount   = 0;
  selectedIndex = 0;

  if (!SerialBT.begin("Sonus Quest", true)) {
    scerror("Bluetooth Fail");
    delay(1000);
    return;
  }
  BTScanResults *results = SerialBT.discover(8000);
  if (results) {
    for (int i = 0; i < results->getCount() && deviceCount < MAX_DEVICES; i++) {
      BTAdvertisedDevice *dev = results->getDevice(i);
      uint32_t cod        = dev->getCOD();
      uint8_t  majorClass = (cod >> 8) & 0x1F;
      if (majorClass == ESP_BT_COD_MAJOR_DEV_AV) {
        String devName = (dev->getName().length() > 0)
          ? dev->getName().c_str()
          : dev->getAddress().toString().c_str();
        foundDevices[deviceCount].name    = devName;
        foundDevices[deviceCount].address = dev->getAddress().toString().c_str();
        deviceCount++;
      }
    }
  }
  SerialBT.end(); 
  int ypos[] = {29, 38, 47, 56, 65, 74, 83, 92, 101, 110, 119, 128, 137};
  tft.fillScreen(0x1042);
  tft.setFreeFont(&FreeSans9pt7b);
  tft.setTextColor(0xECFA);
  tft.setTextSize(2);
  tft.drawString("connect", 1, -3);
  tft.setFreeFont(NULL);
  tft.setTextSize(1);

  if (deviceCount == 0) {
    tft.setTextColor(0xFFFF);
    tft.drawString("No devices found", 3, ypos[0]);
    return;
  }

  for (int i = 0; i < deviceCount; i++) {
    tft.setTextColor(i == selectedIndex ? 0xF419 : 0xFFFF);
    tft.drawString(foundDevices[i].name.c_str(), 3, ypos[i]);
  }
}

void musicplay(String title, String artist, String duration) {

tft.fillScreen(0x1042);
tft.fillRect(2, 128, 124, 3, 0xB272);
tft.setTextColor(0xFFFF);
tft.setTextSize(1);
tft.setFreeFont(&FreeSans9pt7b);
tft.drawString(title, 2, 104);
tft.setTextColor(0xBDF7);
tft.setFreeFont(NULL);
tft.drawString(duration, 97, 133);
tft.drawLine(1, 129, 126, 129, 0xB272);
tft.drawString("0:00", 2, 133); 
tft.setTextColor(0xFFFF);
tft.drawString(artist, 3, 119);
tft.drawLine(0, 11, 127, 11, 0xFFFF);
tft.drawLine(2, 129, 88, 129, 0xFFFF);
tft.setTextColor(bt_connected ? (uint16_t)0xFFFF : (uint16_t)0xF800);
tft.drawString(getStatusText(), 1, 2);
tft.drawBitmap(37, 37, image_music_sound_wave_bits, 51, 48, 0xFFFF);
tft.drawBitmap(3, 150, image_Voldwn_bits, 6, 6, 0xFFFF);
tft.drawBitmap(117, 150, image_Volup_bits, 8, 6, 0xFFFF);
  tft.drawLine(0, 144, 127, 144, 0xFFFF);
  draw_volume_bar();
}
//BUTTONS init
const int BTN_NEXT = 21;
const int BTN_BACK = 22;
const int CONFIRM = 16;
const int UP = 15;
const int DOWN = 17;/* 
const int RIGHT = 34;
const int LEFT = 13;
 */

void openAudioFile(int songIndex) {
  if (songIndex < 0 || songIndex >= songCount) return;
  if (Filename[songIndex].length() == 0) return;

  audio_sd_ready = false;
  if (audio_file) audio_file.close();

  String path = "/" + Filename[songIndex];
  audio_file = SD.open(path, FILE_READ);
  if (!audio_file) {
    Serial.printf("[BT]  Cannot open audio file: %s\n", path.c_str());
    scerror("Audio file 404");
    audio_sd_ready = false;
  } else {
    Serial.printf("[BT]  Opened: %s  (%llu bytes)\n",
                  path.c_str(), (unsigned long long)audio_file.size());
    audio_sd_ready   = true;
    audio_playing_index = songIndex;
    screenname = "PLAYING";
    musicplay(Title[songIndex], Artist[songIndex], Duration[songIndex]);

  }
}
int32_t get_sound_data(uint8_t* data, int32_t byte_count) {
  if (!audio_sd_ready || !audio_file) {
    memset(data, 0, byte_count);
    return byte_count;
  }

  int32_t bytes_read = (int32_t)audio_file.read(data, (size_t)byte_count);
  if (bytes_read == 0) {
    if (!audio_switch_pending) {
      int next_index = audio_playing_index + 1;
      if (next_index >= songCount) {
        next_index = 0;
      }
      audio_pending_index = next_index;
      audio_switch_pending = true;
    }
    memset(data, 0, byte_count);
    return byte_count;
  }

  if (bytes_read > 0) {
    int16_t* samples = (int16_t*)data;
    int32_t sample_count = bytes_read / sizeof(int16_t);
    float gain = volume_gain;
    for (int32_t i = 0; i < sample_count; i++) {
      int32_t val = (int32_t)(samples[i] * gain);
      if (val > 32767) val = 32767;
      else if (val < -32768) val = -32768;
      samples[i] = (int16_t)val;
    }
  }

  if (bytes_read < byte_count) { 
    memset(data + bytes_read, 0, byte_count - bytes_read);
    bytes_read = byte_count;
  }
  return bytes_read;
}
bool on_device_discovered(const char* name, esp_bd_addr_t addr, int rssi) {
  if (TARGET_SPEAKER == "NULL" || TARGET_SPEAKER.length() == 0) return false;

  if (name && strlen(name) > 0) {
    Serial.printf("[BT]  Discovered: %-30s  RSSI=%d dBm\n", name, rssi);
  }
  if (name && String(name) == TARGET_SPEAKER) {
    Serial.printf("[BT]  *** Target '%s' matched — connecting ***\n",
                  TARGET_SPEAKER.c_str());
    static const esp_bd_addr_t zeroAddr = {0};
    if (memcmp(addr, TARGET_ADDR, sizeof(esp_bd_addr_t)) != 0 &&
        memcmp(addr, zeroAddr,    sizeof(esp_bd_addr_t)) != 0) {
      memcpy(TARGET_ADDR, addr, sizeof(esp_bd_addr_t));
      pending_addr_save = true;  
    }
    return true;
  }
  return false;  
}
void on_connection_state_changed(esp_a2d_connection_state_t state, void*) {
  switch (state) {
    case ESP_A2D_CONNECTION_STATE_DISCONNECTED:
      Serial.printf("[BT]  Disconnected — retrying in %d s\n", RECONNECT_INTERVAL);
      bt_connected      = false;
      bt_status_changed = true;
      break;
    case ESP_A2D_CONNECTION_STATE_CONNECTING:
      Serial.printf("[BT]  Connecting to '%s'...\n", TARGET_SPEAKER.c_str());
      break;
    case ESP_A2D_CONNECTION_STATE_CONNECTED:
      Serial.printf("[BT]  Connected to '%s' — streaming\n", TARGET_SPEAKER.c_str());
      bt_connected      = true;
      bt_status_changed = true;
      break;
    case ESP_A2D_CONNECTION_STATE_DISCONNECTING:
      Serial.println("[BT]  Disconnecting...");
      break;
    default:
      Serial.printf("[BT]  State: %d\n", (int)state);
      break;
  }
}

void setup(){
    Serial.begin(115200);
    delay(500);
    update_volume_gain();
    pinMode(BTN_NEXT, INPUT_PULLUP);
    pinMode(BTN_BACK, INPUT_PULLUP);
    pinMode(CONFIRM, INPUT_PULLUP);/* 
    pinMode(RIGHT, INPUT_PULLUP);
    pinMode(LEFT, INPUT_PULLUP); */

    pinMode(UP, INPUT_PULLUP);
    pinMode(DOWN, INPUT_PULLUP);

    pinMode(TFT_BL, OUTPUT);
    digitalWrite(TFT_BL, HIGH);
    pinMode(SD_CS_PIN, OUTPUT);
    digitalWrite(SD_CS_PIN, HIGH);

    tft.initR(INITR_BLACKTAB);
    tft.setRotation(0);
    tft.setTextWrap(false);
    tft.fillScreen(ST77XX_BLACK);

    boot();
    if (!init_sd(SD_CS_PIN)) {
        Serial.println("[SD] ERROR! Init failed");
        scerror("SD Card Failed");
        while (true) delay(1000);
    }
    File file = SD.open("/data.txt");
    if (!file) {
        TARGET_SPEAKER = "NULL";
        Serial.println("[BT] No data.txt found, using NULL speaker");
    } else {
        while (file.available()) {
            String line = file.readStringUntil('\n');
            line.trim();
            if (line.startsWith("SPEAKER:")) {
                TARGET_SPEAKER = line.substring(8);
                TARGET_SPEAKER.trim();
            } else if (line.startsWith("ADDR:")) {
                String addrStr = line.substring(5);
                addrStr.trim();
                sscanf(addrStr.c_str(), "%hhx:%hhx:%hhx:%hhx:%hhx:%hhx",
                       &TARGET_ADDR[0], &TARGET_ADDR[1], &TARGET_ADDR[2],
                       &TARGET_ADDR[3], &TARGET_ADDR[4], &TARGET_ADDR[5]);
                Serial.printf("[BT] Loaded MAC: %s\n", addrStr.c_str());
            }
        }
        file.close();
    }
    Serial.printf("[BT] Speaker: %s\n", TARGET_SPEAKER.c_str());

    homem();
    get_songlist(0);
    screenname = "HOMEM";

    Serial.println("[BT] Registering BT callbacks");
    a2dp_source.set_auto_reconnect(false);
    a2dp_source.set_on_connection_state_changed(on_connection_state_changed);
    a2dp_source.set_ssid_callback(on_device_discovered);
    a2dp_source.set_data_callback(get_sound_data);
    if (TARGET_SPEAKER != "NULL" && TARGET_SPEAKER.length() > 0) {
        Serial.printf("[BT] Auto-connecting to saved speaker: %s\n", TARGET_SPEAKER.c_str());
        static const esp_bd_addr_t zeroAddr = {0};
        if (memcmp(TARGET_ADDR, zeroAddr, sizeof(esp_bd_addr_t)) != 0) {
            Serial.println("[BT] Using MAC address for fast auto-reconnect");
            a2dp_source.set_auto_reconnect(TARGET_ADDR, 5); // 5 retries before fallback to scanning
        } else {
            a2dp_source.set_auto_reconnect(true, 5);
        }
        static char speakerBuf[64];
        TARGET_SPEAKER.toCharArray(speakerBuf, sizeof(speakerBuf));
        a2dp_source.start(speakerBuf);
    }
}
void loop() {
  if (bt_status_changed) {
    bt_status_changed = false;
    updateStatusBar();
  }
  if (pending_addr_save) {
    pending_addr_save = false;
    saveSpeaker(TARGET_SPEAKER, TARGET_ADDR);
  }

  if (audio_switch_pending) {
    audio_switch_pending = false;
    if (audio_pending_index >= 0 && audio_pending_index < songCount) {
      selectedSong = audio_pending_index;
      openAudioFile(audio_pending_index);
    }
  }

  static bool lastNext = HIGH;
  static bool lastBack = HIGH;
  static bool lastCONFIRM = HIGH;
  static bool lastUP = HIGH;
  static bool lastDOWN = HIGH;/* 
  static bool lastRIGHT = HIGH;
  static bool lastLEFT = HIGH; */

  
  bool nowNext = digitalRead(BTN_NEXT);
  bool nowBack = digitalRead(BTN_BACK);
  bool nowCONFIRM = digitalRead(CONFIRM);
  bool nowUP = digitalRead(UP);
  bool nowDOWN = digitalRead(DOWN);/* 
  bool nowRIGHT = digitalRead(RIGHT);
  bool nowLEFT = digitalRead(LEFT);
 */
   if (lastUP == HIGH && nowUP == LOW) {
    Serial.println("UP Pressed");
    volup();
    delay(150);
  }
    if (lastDOWN == HIGH && nowDOWN == LOW) {
      Serial.println("DOWN Pressed");
      voldown();
      delay(150);
    }
  if (lastNext == HIGH && nowNext == LOW) {
    Serial.println("NEXT Pressed");
    if (screenname == "HOMEM"){
      screenname = "HOMEC";
      homec();
    } else if (screenname == "MUSILIST"){
      if (songCount > 0 && selectedSong < songCount - 1) {
        selectedSong++;
        musiclist();
      }
    } else if (screenname == "CONNECT" && deviceCount > 0) {
      if (selectedIndex < deviceCount - 1) {
        selectedIndex++;
        int ypos[] = {29, 38, 47, 56, 65, 74, 83, 92, 101, 110, 119, 128, 137};
        tft.setFreeFont(NULL);
        tft.setTextSize(1);
        for (int i = 0; i < deviceCount; i++) {
          tft.setTextColor(i == selectedIndex ? 0xF419 : 0xFFFF);
          tft.drawString(foundDevices[i].name.c_str(), 3, ypos[i]);
        }
      }
    }
    delay(150);
  }
  if (lastBack == HIGH && nowBack == LOW) {
    Serial.println("BACK Pressed");
    if (screenname == "HOMEC"){
      screenname = "HOMEM";
      homem();
    } else if (screenname == "MUSILIST"){
      if (songCount > 0 && selectedSong > 0) {
        selectedSong--;
        musiclist();
      }
    } else if (screenname == "CONNECT" && deviceCount > 0) {
      if (selectedIndex > 0) {
        selectedIndex--;
        int ypos[] = {29, 38, 47, 56, 65, 74, 83, 92, 101, 110, 119, 128, 137};
        tft.setFreeFont(NULL);
        tft.setTextSize(1);
        for (int i = 0; i < deviceCount; i++) {
          tft.setTextColor(i == selectedIndex ? 0xF419 : 0xFFFF);
          tft.drawString(foundDevices[i].name.c_str(), 3, ypos[i]);
        }
      }
    } else if (screenname == "CONNECT") {
      screenname = "HOMEC";
      homec();
    }
    delay(150);
  }
  if (lastCONFIRM == HIGH && nowCONFIRM == LOW) {
    Serial.println("CONFIRM Pressed");
    if (screenname == "HOMEM"){
      screenname = "MUSILIST";
      musiclist();
    } else if (screenname == "MUSILIST"){
      if (songCount > 0) {
        openAudioFile(selectedSong);
      }
    } else if (screenname == "HOMEC"){
      screenname = "CONNECT";
      connect();
    } else if (screenname == "CONNECT" && deviceCount > 0) {
      TARGET_SPEAKER = foundDevices[selectedIndex].name;
      Serial.printf("[BT] Connecting to: %s\n", TARGET_SPEAKER.c_str());

      tft.fillScreen(0x1042);
      tft.setFreeFont(&FreeSans9pt7b);
      tft.setTextColor(0xECFA);
      tft.setTextSize(2);
      tft.drawString("connect", 1, -3);
      tft.setFreeFont(NULL);
      tft.setTextSize(1);
      tft.setTextColor(0xFFFF);
      tft.drawString("Connecting to:", 10, 60);
      tft.drawString(TARGET_SPEAKER, 10, 74);

      saveSpeaker(TARGET_SPEAKER, TARGET_ADDR);

      if (a2dp_source.is_connected()) {
        a2dp_source.end(false);
        delay(300);
      }

      esp_bt_gap_set_scan_mode(ESP_BT_NON_CONNECTABLE, ESP_BT_NON_DISCOVERABLE);

      int bondCount = esp_bt_gap_get_bond_device_num();
      if (bondCount > 0) {
        esp_bd_addr_t* bondList = new esp_bd_addr_t[bondCount];
        esp_bt_gap_get_bond_device_list(&bondCount, bondList);
        for (int i = 0; i < bondCount; i++) {
          esp_bt_gap_remove_bond_device(bondList[i]);
        }
        delete[] bondList;
        delay(200);
      }

      esp_bt_gap_set_scan_mode(ESP_BT_CONNECTABLE, ESP_BT_NON_DISCOVERABLE);

      sscanf(foundDevices[selectedIndex].address.c_str(),
             "%hhx:%hhx:%hhx:%hhx:%hhx:%hhx",
             &TARGET_ADDR[0], &TARGET_ADDR[1], &TARGET_ADDR[2],
             &TARGET_ADDR[3], &TARGET_ADDR[4], &TARGET_ADDR[5]);

      static const esp_bd_addr_t zeroAddr = {0};
      if (memcmp(TARGET_ADDR, zeroAddr, sizeof(esp_bd_addr_t)) != 0) {
        a2dp_source.set_auto_reconnect(TARGET_ADDR, 5);
      } else {
        a2dp_source.set_auto_reconnect(true, 5);
      }
      static char speakerBuf[64];
      TARGET_SPEAKER.toCharArray(speakerBuf, sizeof(speakerBuf));
      a2dp_source.start(speakerBuf);

      screenname = "HOMEM";
      homem();
    }
    delay(150);
  }/* 
  if (lastRIGHT == HIGH && nowRIGHT == LOW) {
    Serial.println("RIGHT Pressed");
    if (screenname == "HOMEM"){
      screenname = "MUSILIST";
      musiclist();

    } else if (screenname == "HOMEC"){
      screenname = "CONNECT";
      connect();
    } else if (screenname == "MUSILIST"){
      if (songCount > 0) {
        openAudioFile(selectedSong);
      }
    } else if (screenname == "PLAYING"){
      if (songCount > 0 && selectedSong < songCount - 1) {
        selectedSong++;
        openAudioFile(selectedSong);
      }
    }
    delay(150);
  }
  if (lastLEFT == HIGH && nowLEFT == LOW) {
    Serial.println("LEFT Pressed");
    if (screenname == "MUSILIST"){
      screenname = "HOMEM";
      homem();
    } else if (screenname == "CONNECT"){
      screenname = "HOMEC";
      homec();
    } else if (screenname == "PLAYING"){
      if (songCount > 0 && selectedSong > 0) {
        selectedSong--;
        openAudioFile(selectedSong);
      }
    }
    delay(150);
  }
  
  static unsigned long leftPressStart = 0;
  if (lastLEFT == LOW && nowLEFT == LOW) {
    if (leftPressStart == 0) {
      leftPressStart = millis();
    } else if (millis() - leftPressStart > 2000) { 
      Serial.println("LEFT Long Pressed");
      if (screenname == "PLAYING") {
        screenname = "MUSILIST";
        musiclist();
      }
      leftPressStart = 0; 
    }
  } else {
    leftPressStart = 0; 
  } */
  lastNext    = nowNext;
  lastBack    = nowBack;
  lastCONFIRM = nowCONFIRM;
  lastUP      = nowUP;   
  lastDOWN    = nowDOWN; 
  /* lastRIGHT = nowRIGHT;
  lastLEFT = nowLEFT; */
}